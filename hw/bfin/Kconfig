## hw/bfin/Kconfig
```kconfig
# SPDX-License-Identifier: GPL-2.0-or-later
config BF531
    bool
    select UNIMP
    select BFIN_DMA
    select BFIN_PPI
    select BFIN_SPORT

config CDJ2KNXS_GUI
    bool
    default y
    depends on BFIN
    select BF531
```

## hw/tic6x/Kconfig
```kconfig
# SPDX-License-Identifier: GPL-2.0-or-later
config CDJ2KNXS_DSP
    bool
    default y
    depends on TIC6X
```
